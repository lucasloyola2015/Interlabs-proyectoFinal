## sdkconfig.defaults
```kconfig
# ESP-IDF SDK Configuration Defaults
# DataLogger optimizations

# Increase UART buffer
CONFIG_UART_ISR_IN_IRAM=y

# Wear leveling configuration
CONFIG_WL_SECTOR_SIZE_4096=y

# FreeRTOS optimizations for dual-core
CONFIG_FREERTOS_UNICORE=n
CONFIG_FREERTOS_HZ=1000

# Logging level (set to INFO for production, DEBUG for development)
CONFIG_LOG_DEFAULT_LEVEL_INFO=y
CONFIG_LOG_MAXIMUM_LEVEL_DEBUG=y

# Disable timestamp in logs
# CONFIG_LOG_TIMESTAMP_SOURCE_RTOS is not set
# CONFIG_LOG_TIMESTAMP_SOURCE_SYSTEM is not set

# Enable NVS
CONFIG_NVS_ENCRYPTION=n

# Enable Ethernet and W5500 support
CONFIG_ETH_ENABLED=y
CONFIG_ETH_USE_SPI_ETHERNET=y
CONFIG_ETH_SPI_ETHERNET_W5500=y

# Enable HTTP Server
CONFIG_HTTPD_MAX_REQ_HDR_LEN=1024
CONFIG_HTTPD_MAX_URI_LEN=512

# Compiler warnings configuration
# Disable missing-field-initializers warning (common in ESP-IDF 5.5.0)
CONFIG_COMPILER_WARN_WRITE_STRINGS=n

# Flash size configuration (Match 2MB hardware)
CONFIG_ESPTOOLPY_FLASHSIZE_2MB=y
CONFIG_ESPTOOLPY_FLASHSIZE_DETECT=y
CONFIG_ESPTOOLPY_FLASHSIZE="2MB"

# Increase stack sizes for stability
CONFIG_MAIN_TASK_STACK_SIZE=8192
CONFIG_ESP_SYSTEM_EVENT_TASK_STACK_SIZE=4096

# SPI Ethernet optimizations
CONFIG_ETH_SPI_ETHERNET_W5500=y
```
